## config/west.yml
```yaml
manifest:
  remotes:
    - name: zmkfirmware
      url-base: https://github.com/zmkfirmware
    - name: kilipan
      url-base: https://github.com/kilipan
    - name: urob
      url-base: https://github.com/urob
  projects:
    - name: zmk
      remote: zmkfirmware
      revision: main
      import: app/west.yml
    - name: zmk-keyboards-zilpzalp
      remote: kilipan
      revision: main
    - name: zmk-unicode
      remote: urob
      revision: main
  self:
    path: config
```
