#include <dt-bindings/zmk/keys.h>

#ifdef ZILPZALP_BLE_FLAG
#include <dt-bindings/zmk/bt.h>
#include <dt-bindings/zmk/outputs.h>
#endif

#include "base_zilpzalp.h"

// zilpzalp key numbers
//     __________________________  __________________________
//    /     0  |  1  |  2  |  3  \/   4 |   5 |   6 |   7    \
// |  8  |  9  | 10  | 11  | 12  /\  13 |  14 |  15 |  16 | 17  |
//    \    18  | 19  | 20    /        \    21 |  22 |  23   /
//          \    24  | 25  /            \  26 |  27    /
//           --------------              --------------

/ {

    keymap {
        compatible = "zmk,keymap";

        aptmak {
            label = "APT";

            bindings = <
                               &kp W          &kp E          &kp R         &kp T         &kp Z         &kp U          &kp I         &kp O
                &hl LCTRL A    &hl LALT S     &hl LGUI D    &hl LSHFT F    &hl RALT G     &hr RALT N     &hr RSHFT J    &hr RGUI K     &hr LALT L     &hr RCTRL P
                               &kp C          &kp V          &kp B                                       &kp M          &comsem        &dotcol
                                                             &my_lt NUM X &my_lt NAV SPACE &my_lt SYM SPACE &my_lt FUN H
            >;
        };
        numbers {
            label = "NUM";

            bindings = <
                                  &kp TAB            &none                &none              &none          &none          &kp N7         &kp N8         &kp N9
                &hl LCTRL KP_PLUS &hl LALT KP_MINUS &hl LGUI KP_ASTERISK &hl LSHFT KP_SLASH &kp RALT       &none          &kp N4         &kp N5         &kp N6         &none
                                  &kp N9            &kp N8               &kp N7                                           &kp N1         &kp N2         &kp N3
                                                             &trans         &trans         &kp E          &kp N0
            >;
        };
        navigation {
            label = "NAV";

            bindings = <
                               &ipad_tile_fullscreen         &ipad_tile_left          &ipad_tile_right         &kp C_VOL_DN   &kp C_VOL_UP     &kp C_PLAY_PAUSE  &kp LESS_THAN &kp GREATER_THAN
                &kp LA(LC(LG(M)))      &kp LA(LC(LG(UP_ARROW)))       &sk LGUI       &sk LSHFT       &kp LG(C)   &kp C_MUTE     &kp LEFT       &kp DOWN       &kp UP         &kp RIGHT
                               &kp LA(RC(RG(LEFT)))       &kp LA(LC(LG(DOWN)))      &kp LA(LC(LG(RIGHT)))                                      &kp HOME       &kp LEFT      &kp DOWN
                                                             &kp LG(V)          &trans         &kp MINUS         &kp PLUS
            >;
        };
        symbols {
            label = "SYM";

            bindings = <
                /* 0–7  |  Ć Č Š Đ  ||  { } [ ]  */
                &kp LS(SQT)            &kp LS(SEMICOLON)      &kp LS(LEFT_BRACKET)   &kp LS(RIGHT_BRACKET)   &kp LS(LA(LBRC))        &kp LS(LA(RBRC))        &macro_lbkt           &macro_rbkt

                /* 8–17 |  ! : # $ Ž ||  ' + ( % &  */
                &kp EXCL               &macro_at            &kp HASH               &kp DOLLAR              &kp LS(BACKSLASH)   &kp AMPERSAND               &macro_dquote  &kp KP_PLUS        &kp PERCENT         &macro_amp

                /* 18–23 |  < > ?     ||  ( ) + &  */
                &macro_lt               &macro_gt           &kp UNDERSCORE                                   &kp LS(N8)          &kp LS(N9)          &kp KP_PLUS

                /* 24–27 |  = TRNS || TRNS TRNS  */
                                            &kp KP_EQUAL     &trans                 &trans                 &trans
            >;
        };
#ifdef ZILPZALP_BLE_FLAG
        function {
            label = "FUN";

            bindings = <
                               &kp SQT    &kp SEMICOLON        &kp LEFT_BRACKET &kp RIGHT_BRACKET     &kp RIGHT_BRACKET         &bt BT_SEL 1          &macro_bt_reconnect_2         &bt BT_CLR_ALL 
                &kp LC(LG(Q))  &trans         &trans         &out OUT_TOG         &kp BACKSLASH     &kp F11        &kp F4         &kp F5         &kp F6         &kp F10
                               &trans          &trans          &none                                       &kp F1         &kp F2         &kp F3
                                                             &none    &trans         &trans         &trans
            >;
#endif
#ifndef ZILPZALP_BLE_FLAG
        function {
            label = "FUN";

            bindings = <
                               &trans          &trans         &trans         &trans         &kp F12        &kp F7         &kp F8         &kp F9
                &kp LC(LG(Q))  &trans          &trans          &trans        &trans         &kp F11        &kp F4         &kp F5         &kp F6         &kp F10
                               &trans           &trans          &trans                                     &kp F1         &kp F2         &kp F3
                                                             &trans         &trans         &trans         &trans
            >;
           
         
#endif
        };

    };
};

//     __________________________  __________________________
//    /     1  |  2  |  3  |  4  \/   5 |   6 |   7 |   8    \
// | 10  | 11  | 12  | 13  | 14  ||  15 |  16 |  17 |  18 | 19  |
//    \    20  | 21  | 22  |     ||     |  23 |  24 |  25   /
//                \    26  | 27  /\  28 |  29    /
//                 --------------  --------------
